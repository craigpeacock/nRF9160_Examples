## CMakeLists.txt
```
#
# Copyright (c) 2020 Nordic Semiconductor
#
# SPDX-License-Identifier: LicenseRef-Nordic-5-Clause
#

cmake_minimum_required(VERSION 3.20.0)

find_package(Zephyr REQUIRED HINTS $ENV{ZEPHYR_BASE})
project(aws_iot)

# NORDIC SDK APP START
target_sources(app PRIVATE src/main.c src/lte.c src/dfu.c src/aws.c src/datetime.c src/json_support.c)
# NORDIC SDK APP END

zephyr_include_directories(src)
```

## prj.conf
```kconfig
#
# Copyright (c) 2020 Nordic Semiconductor ASA
#
# SPDX-License-Identifier: LicenseRef-Nordic-5-Clause
#
# General config
CONFIG_NCS_SAMPLES_DEFAULTS=y
CONFIG_REBOOT=y
CONFIG_HW_ID_LIBRARY=y
CONFIG_HW_ID_LIBRARY_SOURCE_IMEI=y

# NEWLIB C
CONFIG_NEWLIB_LIBC=y
CONFIG_NEWLIB_LIBC_FLOAT_PRINTF=y

# Network
CONFIG_NETWORKING=y
CONFIG_NET_NATIVE=n

# LTE link control
CONFIG_LTE_LINK_CONTROL=y
CONFIG_LTE_NETWORK_MODE_LTE_M=y

# Modem library
CONFIG_NRF_MODEM_LIB=y

# AT Host
CONFIG_UART_INTERRUPT_DRIVEN=y
CONFIG_AT_HOST_LIBRARY=y

# AWS IoT library
CONFIG_AWS_IOT=y
CONFIG_AWS_IOT_BROKER_HOST_NAME="a3di5eo9fcyqmc-ats.iot.us-east-1.amazonaws.com"
CONFIG_AWS_IOT_TOPIC_UPDATE_DELTA_SUBSCRIBE=n
CONFIG_AWS_IOT_TOPIC_GET_ACCEPTED_SUBSCRIBE=n
CONFIG_AWS_IOT_TOPIC_GET_REJECTED_SUBSCRIBE=n

# MQTT helper library
CONFIG_MQTT_HELPER=y
CONFIG_MQTT_HELPER_SEC_TAG=12345678
CONFIG_MQTT_HELPER_LAST_WILL=y
CONFIG_MQTT_HELPER_STACK_SIZE=4096

# MQTT - Maximum MQTT keepalive timeout specified by AWS IoT Core
CONFIG_MQTT_KEEPALIVE=1200
CONFIG_MQTT_CLEAN_SESSION=y

# Date Time library
CONFIG_DATE_TIME=y

# Modem information
CONFIG_MODEM_INFO=y

# Heap and stacks
CONFIG_HEAP_MEM_POOL_SIZE=8192
CONFIG_MAIN_STACK_SIZE=4096
CONFIG_SYSTEM_WORKQUEUE_STACK_SIZE=2048

# MCUBOOT
CONFIG_BOOTLOADER_MCUBOOT=y
CONFIG_MCUBOOT_IMG_MANAGER=y

# Image manager
CONFIG_IMG_MANAGER=y
CONFIG_STREAM_FLASH=y
CONFIG_FLASH_MAP=y
CONFIG_FLASH=y
CONFIG_IMG_ERASE_PROGRESSIVELY=y

# AWS FOTA
CONFIG_AWS_FOTA=y
CONFIG_FOTA_DOWNLOAD=y
CONFIG_DFU_TARGET=y

# CJSON
CONFIG_CJSON_LIB=y

# Download client (needed by AWS FOTA)
CONFIG_DOWNLOAD_CLIENT=y
CONFIG_DOWNLOAD_CLIENT_STACK_SIZE=4096
```

## src/main.c
```c
/*
 * Copyright (c) 2020 Nordic Semiconductor ASA
 *
 * SPDX-License-Identifier: LicenseRef-Nordic-5-Clause
 */

#include <zephyr/kernel.h>
#include <stdio.h>
#include <stdlib.h>
#if defined(CONFIG_NRF_MODEM_LIB)
#include <modem/lte_lc.h>
#include <modem/nrf_modem_lib.h>
#include <modem/modem_info.h>
#include <nrf_modem.h>
#endif
#include <net/aws_iot.h>
#include <zephyr/sys/reboot.h>
#include <date_time.h>
#include <zephyr/dfu/mcuboot.h>
#include <cJSON.h>
#include <cJSON_os.h>
#include <hw_id.h>

#include "datetime.h"
#include "lte.h"
#include "dfu.h"
#include "aws.h"
#include "json_support.h"
#include "main.h"

BUILD_ASSERT(!IS_ENABLED(CONFIG_LTE_AUTO_INIT_AND_CONNECT),
		"This sample does not support LTE auto-init and connect");

struct k_work_delayable shadow_update_work;
struct k_work_delayable connect_work;
struct k_work shadow_update_version_work;

bool cloud_connected;

static char hw_id[HW_ID_LEN];

int main(void)
{
	int err;

	printk("The AWS IoT sample started, version: %s\n", CONFIG_APP_VERSION);

	cJSON_Init();

	// This example supports Amazon Web Services firmware over-the-air (AWS FOTA)
	// Update. Check update status, if FW update has just occured.
	nrf_modem_lib_dfu_handler();

	// Initialise modem information module. Used to request battery voltage data
	// from the modem
	err = modem_info_init();
	if (err) {
		printk("Failed initializing modem info module, error: %d\n", err);
	}

	// Obtain the modems' IMEI (International Mobile Equipment Identity). We use
	// this as the client ID (thing ID) when communicating with the AWS IoT Broker
	err = hw_id_get(hw_id, ARRAY_SIZE(hw_id));
	if (err) {
		printk("Failed to retrieve hardware ID, error: %d", err);
		return err;
	}

	printk("IMEI: %s\n", hw_id);

	// The AWS IOT Client ID should match the 'Thing Name' on the 
	// AWS IoT console. It can be set in the prj.conf using: 
	// CONFIG_AWS_IOT_CLIENT_ID_STATIC="<Thing Name>" 
	// or at run time using the aws_iot_config structure passed 
	// to aws_iot_connect(); If using this option, set 
	// CONFIG_AWS_IOT_CLIENT_ID_APP=y
	
	// Setting the Client ID at runtime allows the developer to 
	// easly deploy fleets of devices with the same firmware. 
	// In this case we read the modem's IMEI and use this as
	// the Client ID.

	// Initialise Amazon Web Services IoT Module
	err = aws_iot_init(aws_iot_event_handler);
	if (err) {
		printk("AWS IoT library could not be initialized, error: %d\n", err);
	}

	// Subscribe to customizable non-shadow specific topics.
	// Topics will be subscribed to upon connection to AWS IoT broker.
	err = app_topics_subscribe();
	if (err) {
		printk("Adding application specific topics failed, error: %d\n", err);
	}

	// Initialise Workqueue Threads 
	// Thread connect_work is responsible for connecting and reconnecting to the 
	// AWS IoT broker.
	k_work_init_delayable(&connect_work, connect_work_fn);
	// Thread shadow_update_version_work only publishes a message (with version 
	// number) upon an initial connection. 
	k_work_init(&shadow_update_version_work, shadow_update_version_work_fn);
	// Thread shadow_update_work continues to periodically publish a message 
	// (without version number)
	k_work_init_delayable(&shadow_update_work, shadow_update_work_fn);
		
	// Initialise LTE modem and LTE handler callback
	modem_configure();

	// Wait for LTE modem to connect 
	k_sem_take(&lte_connected, K_FOREVER);

	// Update date & time
	date_time_update_async(date_time_event_handler);

	// Initiate connection to AWS IoT MQTT 
	k_work_schedule(&connect_work, K_NO_WAIT);
}

void connect_work_fn(struct k_work *work)
{
	int err;

	if (cloud_connected) {
		return;
	}

	const struct aws_iot_config config = {
		.client_id = hw_id,
	};

	// Connect to AWS IoT broker (MQTT)
	err = aws_iot_connect(&config);
	if (err) {
		printk("aws_iot_connect, error: %d\n", err);
	}

	printk("Next connection retry in %d seconds\n", CONFIG_CONNECTION_RETRY_TIMEOUT_SECONDS);

	k_work_schedule(&connect_work, K_SECONDS(CONFIG_CONNECTION_RETRY_TIMEOUT_SECONDS));
}

void shadow_update_work_fn(struct k_work *work)
{
	int err;

	if (!cloud_connected) {
		return;
	}

	// Update shadow with-out version number (Type 1)
	err = shadow_update(false);
	if (err) {
		printk("shadow_update, error: %d\n", err);
	}

	printk("Next data publication in %d seconds\n", CONFIG_PUBLICATION_INTERVAL_SECONDS);

	k_work_schedule(&shadow_update_work, K_SECONDS(CONFIG_PUBLICATION_INTERVAL_SECONDS));
}

void shadow_update_version_work_fn(struct k_work *work)
{
	int err;

	// Update shadow with version number (Type 2)
	err = shadow_update(true);
	if (err) {
		printk("shadow_update, error: %d\n", err);
	}
}
```

## src/aws.c
```c
#include <zephyr/kernel.h>
#include <stdio.h>
#include <stdlib.h>
#include <net/aws_iot.h>
#include <modem/lte_lc.h>
#include <modem/nrf_modem_lib.h>
#include <modem/modem_info.h>
#include <nrf_modem.h>
#include <cJSON.h>
#include <cJSON_os.h>
#include <zephyr/sys/reboot.h>
#include <zephyr/dfu/mcuboot.h>
#include <date_time.h>
#include "json_support.h"
#include "aws.h"
#include "main.h"

#define PSM_ENABLED

#define AWS_IOT_PUB_CUSTOM_TOPIC "my-custom-topic/status"
#define AWS_IOT_SUB_CUSTOM_TOPIC "my-custom-topic/set"

#define MY_CUSTOM_TOPIC_1  "my-custom-topic/example"
#define MY_CUSTOM_TOPIC_2  "my-custom-topic/example2"

int app_topics_subscribe(void)
{
	int err;

	// By default, connection made to AWS IoT Broker is using a persistent 
	// session. This means the broker will store subscriptions. Any topic name 
	// modifications may not become active until the persistant connection 
	// session expiration time elapses.
	// https://docs.aws.amazon.com/iot/latest/developerguide/mqtt.html#mqtt-persistent-sessions

	// If modifing topic names, you may wish to temporary add the following
	// to your prj.conf to create a clean session on each connection.
	// CONFIG_MQTT_CLEAN_SESSION=y
		
	// If persistance sessions are enabled, on the nRF9160 console you should
	// see the following statement after aws_iot_connect() is called.
	//  AWS_IOT_EVT_CONNECTED
	// *Persistent session enabled

	static const struct mqtt_topic topic_list[] = {
		{
			.topic.utf8 = MY_CUSTOM_TOPIC_1,
			.topic.size = strlen(MY_CUSTOM_TOPIC_1),
			.qos = MQTT_QOS_1_AT_LEAST_ONCE,
		},
		{
			.topic.utf8 = MY_CUSTOM_TOPIC_2,
			.topic.size = strlen(MY_CUSTOM_TOPIC_2),
			.qos = MQTT_QOS_1_AT_LEAST_ONCE,
		}
	};

	err = aws_iot_application_topics_set(topic_list, ARRAY_SIZE(topic_list));
	if (err) {
		printk("aws_iot_subscription_topics_add, error: %d\n", err);
	}

	return err;
}

int shadow_update(bool version_number_include)
{
	int err;
	char *message;
	int64_t message_ts = 0;
	int16_t bat_voltage = 0;

	err = date_time_now(&message_ts);
	if (err) {
		printk("date_time_now, error: %d\n", err);
		return err;
	}

#if defined(CONFIG_NRF_MODEM_LIB)
	/* Request battery voltage data from the modem. */
	err = modem_info_short_get(MODEM_INFO_BATTERY, &bat_voltage);
	if (err != sizeof(bat_voltage)) {
		printk("modem_info_short_get, error: %d\n", err);
		return err;
	}
#endif

	cJSON *root_obj = cJSON_CreateObject();
	cJSON *state_obj = cJSON_CreateObject();
	cJSON *reported_obj = cJSON_CreateObject();

	if (root_obj == NULL || state_obj == NULL || reported_obj == NULL) {
		cJSON_Delete(root_obj);
		cJSON_Delete(state_obj);
		cJSON_Delete(reported_obj);
		err = -ENOMEM;
		return err;
	}

	if (version_number_include) {
		err = json_add_str(reported_obj, "app_version",
				    CONFIG_APP_VERSION);
	} else {
		err = 0;
	}

	err += json_add_number(reported_obj, "batv", bat_voltage);
	err += json_add_number(reported_obj, "ts", message_ts);
	err += json_add_obj(state_obj, "reported", reported_obj);
	err += json_add_obj(root_obj, "state", state_obj);

	if (err) {
		printk("json_add, error: %d\n", err);
		goto cleanup;
	}

	message = cJSON_Print(root_obj);
	if (message == NULL) {
		printk("cJSON_Print, error: returned NULL\n");
		err = -ENOMEM;
		goto cleanup;
	}

	struct aws_iot_data tx_data = {
		.qos = MQTT_QOS_0_AT_MOST_ONCE,
		.topic.type = AWS_IOT_SHADOW_TOPIC_UPDATE,
		.ptr = message,
		.len = strlen(message)
	};

	printk("Publishing: %s to AWS IoT broker\n", message);

	err = aws_iot_send(&tx_data);
	if (err) {
		printk("aws_iot_send, error: %d\n", err);
	}

	cJSON_FreeString(message);

cleanup:

	cJSON_Delete(root_obj);

	return err;
}

int publish_custom_topic(void)
{
	int err;
	char *message;

	cJSON *root_obj = cJSON_CreateObject();

	if (root_obj == NULL) {
		cJSON_Delete(root_obj);
		err = -ENOMEM;
		return err;
	}

	err = json_add_number(root_obj, "Test", 1);
	
	if (err) {
		printk("json_add, error: %d\n", err);
		goto cleanup;
	}

	message = cJSON_Print(root_obj);
	if (message == NULL) {
		printk("cJSON_Print, error: returned NULL\n");
		err = -ENOMEM;
		goto cleanup;
	}

	struct aws_iot_data tx_data = {
		.qos = MQTT_QOS_0_AT_MOST_ONCE,
		.topic.str = AWS_IOT_PUB_CUSTOM_TOPIC,
		.topic.len = strlen(AWS_IOT_PUB_CUSTOM_TOPIC),
		.ptr = message,
		.len = strlen(message)
	};

	printk("Publishing: %s to AWS IoT broker\n", message);

	err = aws_iot_send(&tx_data);
	if (err) {
		printk("aws_iot_send, error: %d\n", err);
	}

	cJSON_FreeString(message);

cleanup:

	cJSON_Delete(root_obj);

	return err;
}

void print_received_data(const char *buf, const char *topic, size_t topic_len)
{
	char *str = NULL;
	cJSON *root_obj = NULL;

	root_obj = cJSON_Parse(buf);
	if (root_obj == NULL) {
		printk("cJSON Parse failure");
		return;
	}

	str = cJSON_Print(root_obj);
	if (str == NULL) {
		printk("Failed to print JSON object");
		goto clean_exit;
	}

	printf("Data received from AWS IoT console:\nTopic: %.*s\nMessage: %s\n",
		topic_len, topic, str);

	cJSON_FreeString(str);

clean_exit:
	cJSON_Delete(root_obj);
}

void process_received_data(const char *buf, const char *topic, size_t topic_len)
{
	// topic may not be null terminated, so need to use topic_len;
	if(strncmp(topic, AWS_IOT_SUB_CUSTOM_TOPIC, topic_len) == 0) {
		//printk("Found AWS_IOT_SUB_CUSTOM_TOPIC\n");
		process_custom_topic(buf, topic, topic_len);
	}
}

void process_custom_topic(const char *buf, const char *topic, size_t topic_len)
{
	// Parses a payload with the following format:
	// {
	//		"reset": 1
	// }

	cJSON *root_obj = NULL;
	int reset;

	root_obj = cJSON_Parse(buf);
	if (root_obj == NULL) {
		printk("cJSON Parse failure");
		return;
	}

	if (cJSON_HasObjectItem(root_obj, "reset")) {
		cJSON *item = NULL;
		item = cJSON_GetObjectItem(root_obj, "reset");
		reset = cJSON_GetNumberValue(item);
		printk("Reset = %d\n",reset);
	}

	cJSON_Delete(root_obj);
}

void aws_iot_event_handler(const struct aws_iot_evt *const evt)
{
	int err;

	switch (evt->type) {
		case AWS_IOT_EVT_CONNECTING:
			printk("AWS_IOT_EVT_CONNECTING\n");
			break;

		case AWS_IOT_EVT_CONNECTED:
			printk("AWS_IOT_EVT_CONNECTED\n");

			cloud_connected = true;
			/* This may fail if the work item is already being processed,
			* but in such case, the next time the work handler is executed,
			* it will exit after checking the above flag and the work will
			* not be scheduled again.
			*/
			(void)k_work_cancel_delayable(&connect_work);

			if (evt->data.persistent_session) {
				printk("Persistent session enabled\n");
			}

	#if defined(CONFIG_NRF_MODEM_LIB)
			/** Successfully connected to AWS IoT broker, mark image as
			 *  working to avoid reverting to the former image upon reboot.
			 */
			boot_write_img_confirmed();
	#endif

			/** Send version number to AWS IoT broker to verify that the
			 *  FOTA update worked.
			 */
			k_work_submit(&shadow_update_version_work);

			/** Start sequential shadow data updates.
			 */
			k_work_schedule(&shadow_update_work, K_SECONDS(CONFIG_PUBLICATION_INTERVAL_SECONDS));

#ifdef PSM_ENABLED
			err = lte_lc_psm_req(true);
			if (err) {
				printk("Requesting PSM failed, error: %d\n", err);
			}
#endif
			break;

		case AWS_IOT_EVT_DISCONNECTED:
			printk("AWS_IOT_EVT_DISCONNECTED\n");
			cloud_connected = false;
			/* This may fail if the work item is already being processed,
			* but in such case, the next time the work handler is executed,
			* it will exit after checking the above flag and the work will
			* not be scheduled again.
			*/
			(void)k_work_cancel_delayable(&shadow_update_work);
			k_work_schedule(&connect_work, K_NO_WAIT);
			break;

		case AWS_IOT_EVT_DATA_RECEIVED:
			printk("AWS_IOT_EVT_DATA_RECEIVED\n");
			print_received_data(evt->data.msg.ptr, evt->data.msg.topic.str,	evt->data.msg.topic.len);
			process_received_data(evt->data.msg.ptr, evt->data.msg.topic.str, evt->data.msg.topic.len);
			break;

		case AWS_IOT_EVT_FOTA_START:
			printk("AWS_IOT_EVT_FOTA_START\n");
			break;

		case AWS_IOT_EVT_FOTA_ERASE_PENDING:
			printk("AWS_IOT_EVT_FOTA_ERASE_PENDING\n");
			printk("Disconnect LTE link or reboot\n");
	#if defined(CONFIG_NRF_MODEM_LIB)
			err = lte_lc_offline();
			if (err) {
				printk("Error disconnecting from LTE\n");
			}
	#endif
			break;

		case AWS_IOT_EVT_FOTA_ERASE_DONE:
			printk("AWS_FOTA_EVT_ERASE_DONE\n");
			printk("Reconnecting the LTE link");
	#if defined(CONFIG_NRF_MODEM_LIB)
			err = lte_lc_connect();
			if (err) {
				printk("Error connecting to LTE\n");
			}
	#endif
			break;

		case AWS_IOT_EVT_FOTA_DONE:
			printk("AWS_IOT_EVT_FOTA_DONE\n");
			printk("FOTA done, rebooting device\n");
			aws_iot_disconnect();
			sys_reboot(0);
			break;

		case AWS_IOT_EVT_FOTA_DL_PROGRESS:
			printk("AWS_IOT_EVT_FOTA_DL_PROGRESS, (%d%%)",
				evt->data.fota_progress);

		case AWS_IOT_EVT_ERROR:
			printk("AWS_IOT_EVT_ERROR, %d\n", evt->data.err);
			break;

		case AWS_IOT_EVT_FOTA_ERROR:
			printk("AWS_IOT_EVT_FOTA_ERROR");
			break;

		default:
			printk("Unknown AWS IoT event type: %d\n", evt->type);
			break;
	}
}
```

## src/aws.h
```c
#define APP_TOPICS_COUNT CONFIG_AWS_IOT_APP_SUBSCRIPTION_LIST_COUNT

int app_topics_subscribe(void);
int shadow_update(bool version_number_include);
void aws_iot_event_handler(const struct aws_iot_evt *const evt);
int publish_custom_topic(void);
void print_received_data(const char *buf, const char *topic, size_t topic_len);
void process_received_data(const char *buf, const char *topic, size_t topic_len);
void process_custom_topic(const char *buf, const char *topic, size_t topic_len);
```

## src/datetime.c
```c
#include <zephyr/kernel.h>
#include <stdio.h>
#include <stdlib.h>
#include <date_time.h>

void date_time_event_handler(const struct date_time_evt *evt)
{
	switch (evt->type) {
		case DATE_TIME_OBTAINED_MODEM:
			printk("DATE_TIME_OBTAINED_MODEM\n");
			break;

		case DATE_TIME_OBTAINED_NTP:
			printk("DATE_TIME_OBTAINED_NTP\n");
			break;

		case DATE_TIME_OBTAINED_EXT:
			printk("DATE_TIME_OBTAINED_EXT\n");
			break;

		case DATE_TIME_NOT_OBTAINED:
			printk("DATE_TIME_NOT_OBTAINED\n");
			break;
			
		default:
			break;
	}
}
```

## src/datetime.h
```c
void date_time_event_handler(const struct date_time_evt *evt);
```

## src/dfu.c
```c
#include <zephyr/kernel.h>
#include <stdio.h>
#include <stdlib.h>
#if defined(CONFIG_NRF_MODEM_LIB)
#include <modem/lte_lc.h>
#include <modem/nrf_modem_lib.h>
#include <modem/modem_info.h>
#include <nrf_modem.h>
#endif
#include <zephyr/sys/reboot.h>
#include <zephyr/dfu/mcuboot.h>

void nrf_modem_lib_dfu_handler(void)
{
	int err;

	err = nrf_modem_lib_init();

	switch (err) {
		case NRF_MODEM_DFU_RESULT_OK:
			printk("Modem update suceeded, reboot\n");
			sys_reboot(SYS_REBOOT_COLD);
			break;

		case NRF_MODEM_DFU_RESULT_UUID_ERROR:
		case NRF_MODEM_DFU_RESULT_AUTH_ERROR:
			printk("Modem update failed, error: %d\n", err);
			printk("Modem will use old firmware\n");
			sys_reboot(SYS_REBOOT_COLD);
			break;

		case NRF_MODEM_DFU_RESULT_HARDWARE_ERROR:
		case NRF_MODEM_DFU_RESULT_INTERNAL_ERROR:
			printk("Modem update malfunction, error: %d, reboot\n", err);
			sys_reboot(SYS_REBOOT_COLD);
			break;
			
		default:
			break;
	}
}
```

## src/dfu.h
```c
void nrf_modem_lib_dfu_handler(void);
```

## src/json_support.c
```c
#include <zephyr/kernel.h>
#include <stdio.h>
#include <stdlib.h>
#include <cJSON.h>
#include <cJSON_os.h>

int json_add_obj(cJSON *parent, const char *str, cJSON *item)
{
	cJSON_AddItemToObject(parent, str, item);

	return 0;
}

int json_add_str(cJSON *parent, const char *str, const char *item)
{
	cJSON *json_str;

	json_str = cJSON_CreateString(item);
	if (json_str == NULL) {
		return -ENOMEM;
	}

	return json_add_obj(parent, str, json_str);
}

int json_add_number(cJSON *parent, const char *str, double item)
{
	cJSON *json_num;

	json_num = cJSON_CreateNumber(item);
	if (json_num == NULL) {
		return -ENOMEM;
	}

	return json_add_obj(parent, str, json_num);
}
```

## src/json_support.h
```c
int json_add_obj(cJSON *parent, const char *str, cJSON *item);
int json_add_str(cJSON *parent, const char *str, const char *item);
int json_add_number(cJSON *parent, const char *str, double item);
```

## src/lte.c
```c
#include <zephyr/kernel.h>
#include <stdio.h>
#include <stdlib.h>
#if defined(CONFIG_NRF_MODEM_LIB)
#include <modem/lte_lc.h>
#include <modem/nrf_modem_lib.h>
#include <modem/modem_info.h>
#include <nrf_modem.h>
#endif
#include "lte.h"

K_SEM_DEFINE(lte_connected, 0, 1);

void modem_configure(void)
{
	int err;

	err = lte_lc_connect_async(lte_handler);
	if (err) {
		printk("Modem could not be configured, err %d\n", err);
		return;
	}
}

void lte_handler(const struct lte_lc_evt *const evt)
{
	switch (evt->type) {
		case LTE_LC_EVT_NW_REG_STATUS:
			if ((evt->nw_reg_status != LTE_LC_NW_REG_REGISTERED_HOME) &&
				(evt->nw_reg_status != LTE_LC_NW_REG_REGISTERED_ROAMING)) {
				break;
			}

			printk("Network registration status: %s\n",
				evt->nw_reg_status == LTE_LC_NW_REG_REGISTERED_HOME ?
				"Connected - home network" : "Connected - roaming");

			k_sem_give(&lte_connected);
			break;

		case LTE_LC_EVT_PSM_UPDATE:
			printk("PSM parameter update: TAU: %d, Active time: %d\n",
				evt->psm_cfg.tau, evt->psm_cfg.active_time);
			break;
			
		case LTE_LC_EVT_EDRX_UPDATE: {
			char log_buf[60];
			ssize_t len;

			len = snprintf(log_buf, sizeof(log_buf),
					"eDRX parameter update: eDRX: %f, PTW: %f",
					evt->edrx_cfg.edrx, evt->edrx_cfg.ptw);
			if (len > 0) {
				printk("%s\n", log_buf);
			}
			break;
		}

		case LTE_LC_EVT_RRC_UPDATE:
			printk("RRC mode: %s\n",
				evt->rrc_mode == LTE_LC_RRC_MODE_CONNECTED ?
				"Connected" : "Idle");
			break;

		case LTE_LC_EVT_CELL_UPDATE:
			printk("LTE cell changed: Cell ID: %d, Tracking area: %d\n",
				evt->cell.id, evt->cell.tac);
			break;

		default:
			break;
	}
}
```

## src/lte.h
```c
extern struct k_sem lte_connected;

void lte_handler(const struct lte_lc_evt *const evt);
void modem_configure(void);
```

## src/main.h
```c
extern struct k_work_delayable shadow_update_work;
extern struct k_work_delayable connect_work;
extern struct k_work shadow_update_version_work;

extern bool cloud_connected;

void connect_work_fn(struct k_work *work);
void shadow_update_work_fn(struct k_work *work);
void shadow_update_version_work_fn(struct k_work *work);
```
